## boards/shields/lism/Kconfig.defconfig
```kconfig
if SHIELD_LISM_L || SHIELD_LISM_R
    config ZMK_KEYBOARD_NAME
        default "LisM"

    config NFCT_PINS_AS_GPIOS
        default y

    config ZMK_SPLIT
        default y

    config ZMK_POINTING
        default y

    config ZMK_MOUSE
        default y
    
    config PAW3222
        default y
    
    config INPUT
        default y
    
    config SPI
        default y
endif
config ZMK_BT_RECOVERY
    default y if ZMK_ZEROSHIFT && ZMK_SPLIT_BLE && !ZMK_SETTINGS_RESET_ON_START

config ZMK_BT_RECOVERY_DIAGNOSTICS
    default y if ZMK_BT_RECOVERY
```

## config/west.yml
```yaml
manifest:
  remotes:
    - name: zmkfirmware
      url-base: https://github.com/zmkfirmware
    - name: sekigon-gonnoc
      url-base: https://github.com/sekigon-gonnoc
    - name: caksoylar
      url-base: https://github.com/caksoylar
    - name: 4mplelab
      url-base: https://github.com/4mplelab
  projects:
    - name: zmk-feature-zeroshift
      url: https://github.com/te9no/zmk-feature-zeroshift
      revision: 666ec6e8f91a2130e32c30cfc805c555de6a1d47
    - name: zmk-module-bt-recovery
      url: https://github.com/te9no/zmk-module-bt-recovery
      revision: 7e76381d90856a42e739cebf66752afebbe78748
      path: modules/zmk-module-bt-recovery
    - name: zmk
      url: https://github.com/te9no/zmk
      revision: 7687cece804d509e70da98e16d963e3f7c88ac71
      import: app/west.yml
    - name: zmk-driver-paw3222
      remote: sekigon-gonnoc
      revision: df652881be2520bde4f64ab6ca35e4c5708f4f9b
    - name: zmk-rgbled-widget
      remote: caksoylar
      # v0.3 support was split out to v0.3-branch; main now tracks ZMK main/Zephyr 4.x
      revision: e6b467792a1dabef8cfa5c9fd26bfefc9c16662b
    - name: zmk-feature-charge-indicator
      remote: 4mplelab
      revision: f0d311ed7804cda0e5837ef902f0419aeace4a88
  self:
    path: config
```

## dts/bindings/sensor/lism,deferred-ec11.yaml
```yaml
# SPDX-License-Identifier: MIT

description: EC11 encoder on a LisM slot initialized from the saved module selection
compatible: "lism,deferred-ec11"

include:
  - name: alps,ec11.yaml
  - name: base.yaml
    property-allowlist:
      - zephyr,deferred-init
```
